## aiHardStudy/cloud/jobs/75a27110/sdkconfig.defaults
```kconfig
# Partition Table
CONFIG_PARTITION_TABLE_CUSTOM=y
CONFIG_PARTITION_TABLE_CUSTOM_FILENAME="partitions.csv"

# Bluetooth
CONFIG_BT_ENABLED=y
CONFIG_BT_NIMBLE_ENABLED=y
CONFIG_BT_NIMBLE_MAX_CONNECTIONS=1
CONFIG_BT_NIMBLE_ROLE_CENTRAL=n
CONFIG_BT_NIMBLE_ROLE_OBSERVER=n

# Flash
CONFIG_ESPTOOLPY_FLASHSIZE_4MB=y

# NimBLE store 완전 비활성화 (IRK StoreProhibited 크래시 방지)
CONFIG_BT_NIMBLE_NVS_PERSIST=n
CONFIG_BT_NIMBLE_STORE_CONFIG_PERSIST=n

# NimBLE Security/Bonding 비활성화 (OTA에 불필요)
CONFIG_BT_NIMBLE_SM_LEGACY=n
CONFIG_BT_NIMBLE_SM_SC=n

# OTA
CONFIG_BOOTLOADER_APP_ROLLBACK_ENABLE=y
```
