#ifndef SSD1306_H
#define SSD1306_H

#include <stdint.h>
#include "driver/i2c.h"

#define SSD1306_ADDR    0x3C
#define SSD1306_W       128
#define SSD1306_H       64
#define SSD1306_PAGES   (SSD1306_H / 8)

// 프레임 버퍼 (128x64 = 1024 bytes, page 방식)
static uint8_t ssd1306_buf[SSD1306_W * SSD1306_PAGES];

static void ssd1306_cmd(i2c_port_t port, uint8_t cmd)
{
    uint8_t data[2] = {0x00, cmd};
    i2c_master_write_to_device(port, SSD1306_ADDR, data, 2, 100 / portTICK_PERIOD_MS);
}

static void ssd1306_init(i2c_port_t port)
{
    const uint8_t cmds[] = {
        0xAE,       // display off
        0xD5, 0x80, // clock div
        0xA8, 0x3F, // multiplex 64
        0xD3, 0x00, // display offset
        0x40,       // start line 0
        0x8D, 0x14, // charge pump enable
        0x20, 0x00, // horizontal addressing
        0xA1,       // segment remap
        0xC8,       // COM scan dec
        0xDA, 0x12, // COM pins
        0x81, 0xCF, // contrast
        0xD9, 0xF1, // precharge
        0xDB, 0x40, // VCOMH
        0xA4,       // display from RAM
        0xA6,       // normal display
        0xAF,       // display on
    };
    for (int i = 0; i < sizeof(cmds); i++) {
        ssd1306_cmd(port, cmds[i]);
    }
}

static void ssd1306_clear(void)
{
    memset(ssd1306_buf, 0, sizeof(ssd1306_buf));
}

static void ssd1306_flush(i2c_port_t port)
{
    ssd1306_cmd(port, 0x21); ssd1306_cmd(port, 0); ssd1306_cmd(port, 127); // col range
    ssd1306_cmd(port, 0x22); ssd1306_cmd(port, 0); ssd1306_cmd(port, 7);   // page range

    // Send buffer in chunks
    for (int i = 0; i < sizeof(ssd1306_buf); i += 128) {
        uint8_t tmp[129];
        tmp[0] = 0x40; // data mode
        memcpy(tmp + 1, ssd1306_buf + i, 128);
        i2c_master_write_to_device(port, SSD1306_ADDR, tmp, 129, 100 / portTICK_PERIOD_MS);
    }
}

// 가로 비트맵을 page 버퍼에 그리기
// bitmap: 가로 바이트 패킹 (MSB first), 128xh 크기
// y: 시작 y 좌표 (0~63)
static void ssd1306_draw_hbitmap(int x, int y, int w, int h, const uint8_t *bitmap)
{
    int bytes_per_row = (w + 7) / 8;
    for (int row = 0; row < h; row++) {
        int yy = y + row;
        if (yy >= SSD1306_H) break;
        int page = yy / 8;
        uint8_t bit = 1 << (yy % 8);
        for (int col = 0; col < w; col++) {
            int xx = x + col;
            if (xx >= SSD1306_W) break;
            int byte_idx = row * bytes_per_row + col / 8;
            if (bitmap[byte_idx] & (0x80 >> (col % 8))) {
                ssd1306_buf[page * SSD1306_W + xx] |= bit;
            }
        }
    }
}

// 기본 5x7 ASCII 폰트 (간략 버전, 0x20~0x7E)
static const uint8_t font5x7[][5] = {
    {0x00,0x00,0x00,0x00,0x00}, // space
    {0x00,0x00,0x5F,0x00,0x00}, // !
    {0x00,0x07,0x00,0x07,0x00}, // "
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    {0x44,0x64,0x54,0x4C,0x44}, // z
};

static void ssd1306_draw_char(int x, int y, char c)
{
    if (c < 0x20 || c > 0x7A) c = ' ';
    int idx = c - 0x20;
    for (int col = 0; col < 5; col++) {
        uint8_t line = font5x7[idx][col];
        for (int row = 0; row < 7; row++) {
            if (line & (1 << row)) {
                int yy = y + row;
                int xx = x + col;
                if (xx < SSD1306_W && yy < SSD1306_H) {
                    ssd1306_buf[(yy / 8) * SSD1306_W + xx] |= (1 << (yy % 8));
                }
            }
        }
    }
}

static void ssd1306_draw_string(int x, int y, const char *str)
{
    while (*str) {
        ssd1306_draw_char(x, y, *str++);
        x += 6;
    }
}

#endif
