#ifndef SSD1306_H
#define SSD1306_H

#include <Wire.h>

class SSD1306 {
public:
  static const uint8_t ADDR = 0x3C;
  static const int W = 128;
  static const int H = 64;
  uint8_t buf[W * H / 8];
  int sdaPin, sclPin;

  SSD1306(int sda, int scl) : sdaPin(sda), sclPin(scl) {
    memset(buf, 0, sizeof(buf));
  }

  void cmd(uint8_t c) {
    Wire.beginTransmission(ADDR);
    Wire.write(0x00);
    Wire.write(c);
    Wire.endTransmission();
  }

  void init() {
    const uint8_t cmds[] = {
      0xAE, 0xD5, 0x80, 0xA8, 0x3F, 0xD3, 0x00, 0x40,
      0x8D, 0x14, 0x20, 0x00, 0xA1, 0xC8, 0xDA, 0x12,
      0x81, 0xCF, 0xD9, 0xF1, 0xDB, 0x40, 0xA4, 0xA6, 0xAF
    };
    for (int i = 0; i < sizeof(cmds); i++) cmd(cmds[i]);
  }

  void clear() { memset(buf, 0, sizeof(buf)); }

  void display() {
    cmd(0x21); cmd(0); cmd(127);
    cmd(0x22); cmd(0); cmd(7);
    for (int i = 0; i < sizeof(buf); i += 16) {
      Wire.beginTransmission(ADDR);
      Wire.write(0x40);
      int n = (sizeof(buf) - i > 16) ? 16 : sizeof(buf) - i;
      Wire.write(&buf[i], n);
      Wire.endTransmission();
    }
  }

  void pixel(int x, int y, bool on = true) {
    if (x < 0 || x >= W || y < 0 || y >= H) return;
    if (on) buf[x + (y / 8) * W] |= (1 << (y & 7));
    else    buf[x + (y / 8) * W] &= ~(1 << (y & 7));
  }

  // Simple 5x7 font
  void drawChar(int x, int y, char c) {
    static const uint8_t font5x7[][5] PROGMEM = {
      {0x00,0x00,0x00,0x00,0x00}, // space
      {0x00,0x00,0x5F,0x00,0x00}, // !
      {0x00,0x07,0x00,0x07,0x00}, // "
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      {0x61,0x51,0x49,0x45,0x43}, // Z
    };
    if (c < 32 || c > 90) {
      if (c >= 'a' && c <= 'z') c -= 32; // lowercase to upper
      else return;
    }
    int idx = c - 32;
    if (idx >= (int)(sizeof(font5x7)/5)) return;
    for (int col = 0; col < 5; col++) {
      uint8_t line = pgm_read_byte(&font5x7[idx][col]);
      for (int row = 0; row < 7; row++) {
        if (line & (1 << row)) pixel(x + col, y + row);
      }
    }
  }

  void drawString(int x, int y, const char* str) {
    while (*str) {
      drawChar(x, y, *str++);
      x += 6;
      if (x > W - 6) break;
    }
  }
};

#endif
